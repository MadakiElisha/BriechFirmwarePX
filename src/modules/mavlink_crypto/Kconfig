## src/modules/mavlink_crypto/Kconfig
```kconfig
menuconfig MODULES_MAVLINK_CRYPTO
	bool "mavlink_crypto"
	default n
	---help---
		Enable MAVLink encryption module
```

## src/modules/vtol_nmpc_control/Kconfig
```kconfig
menuconfig MODULES_VTOL_NMPC_CONTROL
	bool "VTOL NMPC Controller"
	default n
	select MODULES_PX4_WORK_QUEUE
	---help---
		High-performance NMPC controller for Quadplanes.
		Uses acados with BLASFEO ARMV7_CORTEX_M7 optimizations
		for real-time VTOL transition and hover control.
```
